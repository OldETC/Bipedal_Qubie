//adafruit24lib.inc
// adafruit 2.4" TFT display
displayboardheight= 62.3; // overall size of display board
displayboardwidth= 52.5;  // overall width of display board
displayboardthick=1.6;     // thickness of board with device space
displayboardwidthmargin=5;    // offset of glass from board width edges
displayboardendmargin=1; // offset from board height edges
TFTheight=60;           // x dimension of glass
TFTwidth=42.3;            // y dimension of glass
TFTthick=4.0;              // display glass assy thick from spec
viewheight=48.96;          // viewable area height
viewheighttopmargin=2.7;   // from top edge of glass to viewing area
viewheightbottommargin=5.1;// from bottom edge of glass to viewing area
viewwidth=36.72;           // viewable width
viewwidthoffset=3;         // offset of view from width edge
mountinghole=2.8;            // hole dia
offsetx=1.3;               // distance from edge
offsety=1.3;               // distance from edge.
